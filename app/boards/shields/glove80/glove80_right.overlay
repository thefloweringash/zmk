/*
 * Copyright (c) 2020 Pete Johanson
 *
 * SPDX-License-Identifier: MIT
 */

#include "glove80.dtsi"

&default_transform {
	col-offset = <7>;
};

&kscan0 {
	row-gpios
		= <&gpio0 26 GPIO_OPEN_SOURCE> // RH ROW1
		, <&gpio0 5 GPIO_OPEN_SOURCE> // RH ROW2
		, <&gpio0 7 GPIO_OPEN_SOURCE> // RH ROW3
		, <&gpio1 8 GPIO_OPEN_SOURCE> // RH ROW4
		, <&gpio0 11 GPIO_OPEN_SOURCE> // RH ROW5
		, <&gpio0 12 GPIO_OPEN_SOURCE> // RH ROW6
		;
	col-gpios
		= <&gpio0 2 (GPIO_ACTIVE_HIGH | GPIO_PULL_DOWN)> // RH Thumb
		, <&gpio1 4 (GPIO_ACTIVE_HIGH | GPIO_PULL_DOWN)> // RH COL1
		, <&gpio1 6 (GPIO_ACTIVE_HIGH | GPIO_PULL_DOWN)> // RH COL2
		, <&gpio1 7 (GPIO_ACTIVE_HIGH | GPIO_PULL_DOWN)> // RH COL3
		, <&gpio1 5 (GPIO_ACTIVE_HIGH | GPIO_PULL_DOWN)> // RH COL4
		, <&gpio1 3 (GPIO_ACTIVE_HIGH | GPIO_PULL_DOWN)> // RH COL5
		, <&gpio1 1 (GPIO_ACTIVE_HIGH | GPIO_PULL_DOWN)> // RH COL6
		;
};
