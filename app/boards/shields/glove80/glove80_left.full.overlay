/*
 * Copyright (c) 2020 Pete Johanson
 *
 * SPDX-License-Identifier: MIT
 */

#include "glove80.dtsi"

&kscan0 {
	row-gpios
		= <&gpio0 26 GPIO_ACTIVE_HIGH> // LH ROW1
		, <&gpio0 5 GPIO_ACTIVE_HIGH> // LH ROW2
		, <&gpio0 7 GPIO_ACTIVE_HIGH> // LH ROW3
		, <&gpio1 8 GPIO_ACTIVE_HIGH> // LH ROW4
		, <&gpio0 11 GPIO_ACTIVE_HIGH> // LH ROW5
		, <&gpio0 12 GPIO_ACTIVE_HIGH> // LH ROW6
		;
	col-gpios
		= <&gpio1 1 (GPIO_ACTIVE_HIGH | GPIO_PULL_DOWN)> // LH COL6
		, <&gpio1 3 (GPIO_ACTIVE_HIGH | GPIO_PULL_DOWN)> // LH COL5
		, <&gpio1 5 (GPIO_ACTIVE_HIGH | GPIO_PULL_DOWN)> // LH COL4
		, <&gpio1 7 (GPIO_ACTIVE_HIGH | GPIO_PULL_DOWN)> // LH COL3
		, <&gpio1 6 (GPIO_ACTIVE_HIGH | GPIO_PULL_DOWN)> // LH COL2
		, <&gpio1 4 (GPIO_ACTIVE_HIGH | GPIO_PULL_DOWN)> // LH COL1
		, <&gpio0 2 (GPIO_ACTIVE_HIGH | GPIO_PULL_DOWN)> // LH Thumb
		;
};
