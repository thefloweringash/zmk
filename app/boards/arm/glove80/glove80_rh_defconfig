## app/boards/arm/glove80/glove80_rh_defconfig
```kconfig
# SPDX-License-Identifier: MIT

CONFIG_SOC_SERIES_NRF52X=y
CONFIG_SOC_NRF52840_QIAA=y
CONFIG_BOARD_GLOVE80_RH=y

# Enable MPU
CONFIG_ARM_MPU=y

# enable GPIO
CONFIG_GPIO=y

CONFIG_BUILD_OUTPUT_UF2=y

CONFIG_USE_DT_CODE_PARTITION=y

CONFIG_MPU_ALLOW_FLASH_WRITE=y
CONFIG_NVS=y
CONFIG_SETTINGS_NVS=y
CONFIG_FLASH=y
CONFIG_FLASH_PAGE_LAYOUT=y
CONFIG_FLASH_MAP=y

# Disable RGB underglow for now in RH
CONFIG_ZMK_RGB_UNDERGLOW=y
CONFIG_WS2812_STRIP=y
CONFIG_SPI=y

CONFIG_ZMK_RGB_UNDERGLOW_EXT_POWER=y
CONFIG_ZMK_RGB_UNDERGLOW_ON_START=n
CONFIG_ZMK_RGB_UNDERGLOW_BRT_STEP=4
CONFIG_ZMK_RGB_UNDERGLOW_BRT_MIN=4
# DO NOT CHANGE CONFIG_ZMK_RGB_UNDERGLOW_BRT_MAX TO > 80
CONFIG_ZMK_RGB_UNDERGLOW_BRT_MAX=80

# [SC] These are additional configurations that need to be implmented
#CONFIG_ZMK_RGB_UNDERGLOW_USB_CONNECTED_BRT_MAX=80 # If your USB charger is not capable of providing 900mA, then this should be changed to a smaller number 
#CONFIG_ZMK_RGB_UNDERGLOW_CONSERVE_BAT_PERCENT=30 # Activate undeglow battery conservation mode at < 30% battery
#CONFIG_ZMK_RGB_UNDERGLOW_CONSERVE_BAT_BRT_MAX=16 # Maximum brightness at battery conservation mode is 16
#CONFIG_ZMK_RGB_UNDERGLOW_DISABLE_BAT_PERCENT=10 # Disable underglow at < 10% battery

CONFIG_ZMK_RGB_UNDERGLOW_HUE_START=285
CONFIG_ZMK_RGB_UNDERGLOW_SAT_START=75
CONFIG_ZMK_RGB_UNDERGLOW_BRT_START=16

# The power LED is implemented as a backlight
# For now, the power LED is acting as a "USB connected" indicator 
CONFIG_ZMK_BACKLIGHT=y
CONFIG_ZMK_BACKLIGHT_ON_START=y
CONFIG_ZMK_BACKLIGHT_BRT_START=5
CONFIG_ZMK_BACKLIGHT_AUTO_OFF_IDLE=y
CONFIG_ZMK_BACKLIGHT_AUTO_OFF_USB=y

# Turn on logging, and set ZMK logging to debug output
# Only for debugging
CONFIG_ZMK_USB_LOGGING=n

# Turn on debugging to disable optimization
CONFIG_DEBUG=n
```

## app/boards/shields/glove80/Kconfig.shield
```kconfig
# Copyright (c) 2020 Pete Johanson
# SPDX-License-Identifier: MIT

config SHIELD_GLOVE80_LEFT
	def_bool $(shields_list_contains,glove80_left)

config SHIELD_GLOVE80_RIGHT
	def_bool $(shields_list_contains,glove80_right)
```
